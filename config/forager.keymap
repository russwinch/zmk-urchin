/*
 * Forager: 34 keys, same positions as Urchin. Layers live in keymap.dtsi.
 * The onboard XIAO RGB LED comes from the rgbled_adapter shield (build.yaml).
 *
 *    0  1  2  3  4      5  6  7  8  9
 *   10 11 12 13 14     15 16 17 18 19
 *   20 21 22 23 24     25 26 27 28 29
 *            30 31     32 33
 */

#define KEYS_L  0 1 2 3 4 10 11 12 13 14 20 21 22 23 24
#define KEYS_R  5 6 7 8 9 15 16 17 18 19 25 26 27 28 29
#define THUMBS  30 31 32 33

#define KB_LAYOUT(k00, k01, k02, k03, k04, k05, k06, k07, k08, k09, k10, k11, k12, k13, k14, k15, k16, k17, k18, k19, k20, k21, k22, k23, k24, k25, k26, k27, k28, k29, k30, k31, k32, k33) \
    k00 k01 k02 k03 k04  k05 k06 k07 k08 k09 \
    k10 k11 k12 k13 k14  k15 k16 k17 k18 k19 \
    k20 k21 k22 k23 k24  k25 k26 k27 k28 k29 \
                k30 k31  k32 k33
#define KB_LAYOUT_BASE KB_LAYOUT

#include "keymap.dtsi"
