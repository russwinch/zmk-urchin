/*
 * splitkb Aurora Corne: 42 keys + 2 encoders. Layers live in keymap.dtsi.
 * Outer columns are unused; the outer thumb keys are mute / play-pause.
 *
 *    0  1  2  3  4  5      6  7  8  9 10 11
 *   12 13 14 15 16 17     18 19 20 21 22 23
 *   24 25 26 27 28 29     30 31 32 33 34 35
 *            36 37 38     39 40 41
 */

#include "leds_nice_nano_rgb.dtsi"

&sensors {
    triggers-per-rotation = <40>;
};

&nice_view_spi {
    cs-gpios = <&pro_micro 0 GPIO_ACTIVE_HIGH>;
};

#define KEYS_L  0 1 2 3 4 5 12 13 14 15 16 17 24 25 26 27 28 29
#define KEYS_R  6 7 8 9 10 11 18 19 20 21 22 23 30 31 32 33 34 35
#define THUMBS  36 37 38 39 40 41

#define CORNE(X_LT, X_RT, k00, k01, k02, k03, k04, k05, k06, k07, k08, k09, k10, k11, k12, k13, k14, k15, k16, k17, k18, k19, k20, k21, k22, k23, k24, k25, k26, k27, k28, k29, k30, k31, k32, k33) \
    XXX k00 k01 k02 k03 k04  k05 k06 k07 k08 k09 XXX \
    XXX k10 k11 k12 k13 k14  k15 k16 k17 k18 k19 XXX \
    XXX k20 k21 k22 k23 k24  k25 k26 k27 k28 k29 XXX \
               X_LT k30 k31  k32 k33 X_RT
#define KB_LAYOUT_BASE(...) CORNE(&kp C_MUTE, &kp C_PP, __VA_ARGS__)
#define KB_LAYOUT(...)      CORNE(___, ___, __VA_ARGS__)

#define SENSORS       sensor-bindings = <&inc_dec_kp C_VOL_DN C_VOL_UP &inc_dec_kp UP DOWN>;
#define SENSORS_LOWER sensor-bindings = <&inc_dec_kp C_VOL_DN C_VOL_UP &inc_dec_kp PG_UP PG_DN>;

#include "keymap.dtsi"
