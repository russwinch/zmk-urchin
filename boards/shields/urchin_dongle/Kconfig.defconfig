## boards/shields/urchin_dongle/Kconfig.defconfig
```kconfig
if SHIELD_URCHIN_DONGLE

# Max 16 characters
config ZMK_KEYBOARD_NAME
    default "urchin"

config ZMK_SPLIT
    default y

config ZMK_SPLIT_ROLE_CENTRAL
    default y

# Left + right halves
config ZMK_SPLIT_BLE_CENTRAL_PERIPHERALS
    default 2

# Peripherals + 5 BT host profiles
config BT_MAX_CONN
    default 7

config BT_MAX_PAIRED
    default 7

endif
```
